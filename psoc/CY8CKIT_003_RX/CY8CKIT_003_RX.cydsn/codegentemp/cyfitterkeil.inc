#ifndef INCLUDED_CYFITTERKEIL_INC
#define INCLUDED_CYFITTERKEIL_INC
$INCLUDE (cydevicekeil.inc)
$INCLUDE (cydevicekeil_trm.inc)

; RadioController_IntClock
RadioController_IntClock__CFG0 EQU CYREG_CLKDIST_DCFG0_CFG0
RadioController_IntClock__CFG1 EQU CYREG_CLKDIST_DCFG0_CFG1
RadioController_IntClock__CFG2 EQU CYREG_CLKDIST_DCFG0_CFG2
RadioController_IntClock__CFG2_SRC_SEL_MASK EQU 0x07
RadioController_IntClock__PM_ACT_CFG EQU CYREG_PM_ACT_CFG2
RadioController_IntClock__PM_ACT_MSK EQU 0x01
RadioController_IntClock__PM_STBY_CFG EQU CYREG_PM_STBY_CFG2
RadioController_IntClock__PM_STBY_MSK EQU 0x01

; RadioController_BSPIM
RadioController_BSPIM_BitCounter_ST__16BIT_STATUS_AUX_CTL_REG EQU CYREG_B0_UDB08_09_ACTL
RadioController_BSPIM_BitCounter_ST__16BIT_STATUS_REG EQU CYREG_B0_UDB08_09_ST
RadioController_BSPIM_BitCounter_ST__MASK_REG EQU CYREG_B0_UDB08_MSK
RadioController_BSPIM_BitCounter_ST__MASK_ST_AUX_CTL_REG EQU CYREG_B0_UDB08_MSK_ACTL
RadioController_BSPIM_BitCounter_ST__PER_ST_AUX_CTL_REG EQU CYREG_B0_UDB08_MSK_ACTL
RadioController_BSPIM_BitCounter_ST__STATUS_AUX_CTL_REG EQU CYREG_B0_UDB08_ACTL
RadioController_BSPIM_BitCounter_ST__STATUS_CNT_REG EQU CYREG_B0_UDB08_ST_CTL
RadioController_BSPIM_BitCounter_ST__STATUS_CONTROL_REG EQU CYREG_B0_UDB08_ST_CTL
RadioController_BSPIM_BitCounter_ST__STATUS_REG EQU CYREG_B0_UDB08_ST
RadioController_BSPIM_BitCounter__16BIT_CONTROL_AUX_CTL_REG EQU CYREG_B0_UDB08_09_ACTL
RadioController_BSPIM_BitCounter__16BIT_CONTROL_CONTROL_REG EQU CYREG_B0_UDB08_09_CTL
RadioController_BSPIM_BitCounter__16BIT_CONTROL_COUNT_REG EQU CYREG_B0_UDB08_09_CTL
RadioController_BSPIM_BitCounter__16BIT_COUNT_CONTROL_REG EQU CYREG_B0_UDB08_09_CTL
RadioController_BSPIM_BitCounter__16BIT_COUNT_COUNT_REG EQU CYREG_B0_UDB08_09_CTL
RadioController_BSPIM_BitCounter__16BIT_MASK_MASK_REG EQU CYREG_B0_UDB08_09_MSK
RadioController_BSPIM_BitCounter__16BIT_MASK_PERIOD_REG EQU CYREG_B0_UDB08_09_MSK
RadioController_BSPIM_BitCounter__16BIT_PERIOD_MASK_REG EQU CYREG_B0_UDB08_09_MSK
RadioController_BSPIM_BitCounter__16BIT_PERIOD_PERIOD_REG EQU CYREG_B0_UDB08_09_MSK
RadioController_BSPIM_BitCounter__CONTROL_AUX_CTL_REG EQU CYREG_B0_UDB08_ACTL
RadioController_BSPIM_BitCounter__CONTROL_REG EQU CYREG_B0_UDB08_CTL
RadioController_BSPIM_BitCounter__CONTROL_ST_REG EQU CYREG_B0_UDB08_ST_CTL
RadioController_BSPIM_BitCounter__COUNT_REG EQU CYREG_B0_UDB08_CTL
RadioController_BSPIM_BitCounter__COUNT_ST_REG EQU CYREG_B0_UDB08_ST_CTL
RadioController_BSPIM_BitCounter__MASK_CTL_AUX_CTL_REG EQU CYREG_B0_UDB08_MSK_ACTL
RadioController_BSPIM_BitCounter__PERIOD_REG EQU CYREG_B0_UDB08_MSK
RadioController_BSPIM_BitCounter__PER_CTL_AUX_CTL_REG EQU CYREG_B0_UDB08_MSK_ACTL
RadioController_BSPIM_RxStsReg__16BIT_STATUS_AUX_CTL_REG EQU CYREG_B1_UDB09_10_ACTL
RadioController_BSPIM_RxStsReg__16BIT_STATUS_REG EQU CYREG_B1_UDB09_10_ST
RadioController_BSPIM_RxStsReg__4__MASK EQU 0x10
RadioController_BSPIM_RxStsReg__4__POS EQU 4
RadioController_BSPIM_RxStsReg__5__MASK EQU 0x20
RadioController_BSPIM_RxStsReg__5__POS EQU 5
RadioController_BSPIM_RxStsReg__6__MASK EQU 0x40
RadioController_BSPIM_RxStsReg__6__POS EQU 6
RadioController_BSPIM_RxStsReg__MASK EQU 0x70
RadioController_BSPIM_RxStsReg__MASK_REG EQU CYREG_B1_UDB09_MSK
RadioController_BSPIM_RxStsReg__STATUS_AUX_CTL_REG EQU CYREG_B1_UDB09_ACTL
RadioController_BSPIM_RxStsReg__STATUS_REG EQU CYREG_B1_UDB09_ST
RadioController_BSPIM_TxStsReg__0__MASK EQU 0x01
RadioController_BSPIM_TxStsReg__0__POS EQU 0
RadioController_BSPIM_TxStsReg__16BIT_STATUS_AUX_CTL_REG EQU CYREG_B1_UDB08_09_ACTL
RadioController_BSPIM_TxStsReg__16BIT_STATUS_REG EQU CYREG_B1_UDB08_09_ST
RadioController_BSPIM_TxStsReg__1__MASK EQU 0x02
RadioController_BSPIM_TxStsReg__1__POS EQU 1
RadioController_BSPIM_TxStsReg__2__MASK EQU 0x04
RadioController_BSPIM_TxStsReg__2__POS EQU 2
RadioController_BSPIM_TxStsReg__3__MASK EQU 0x08
RadioController_BSPIM_TxStsReg__3__POS EQU 3
RadioController_BSPIM_TxStsReg__4__MASK EQU 0x10
RadioController_BSPIM_TxStsReg__4__POS EQU 4
RadioController_BSPIM_TxStsReg__MASK EQU 0x1F
RadioController_BSPIM_TxStsReg__MASK_REG EQU CYREG_B1_UDB08_MSK
RadioController_BSPIM_TxStsReg__STATUS_AUX_CTL_REG EQU CYREG_B1_UDB08_ACTL
RadioController_BSPIM_TxStsReg__STATUS_REG EQU CYREG_B1_UDB08_ST
RadioController_BSPIM_sR8_Dp_u0__16BIT_A0_REG EQU CYREG_B1_UDB08_09_A0
RadioController_BSPIM_sR8_Dp_u0__16BIT_A1_REG EQU CYREG_B1_UDB08_09_A1
RadioController_BSPIM_sR8_Dp_u0__16BIT_D0_REG EQU CYREG_B1_UDB08_09_D0
RadioController_BSPIM_sR8_Dp_u0__16BIT_D1_REG EQU CYREG_B1_UDB08_09_D1
RadioController_BSPIM_sR8_Dp_u0__16BIT_DP_AUX_CTL_REG EQU CYREG_B1_UDB08_09_ACTL
RadioController_BSPIM_sR8_Dp_u0__16BIT_F0_REG EQU CYREG_B1_UDB08_09_F0
RadioController_BSPIM_sR8_Dp_u0__16BIT_F1_REG EQU CYREG_B1_UDB08_09_F1
RadioController_BSPIM_sR8_Dp_u0__A0_A1_REG EQU CYREG_B1_UDB08_A0_A1
RadioController_BSPIM_sR8_Dp_u0__A0_REG EQU CYREG_B1_UDB08_A0
RadioController_BSPIM_sR8_Dp_u0__A1_REG EQU CYREG_B1_UDB08_A1
RadioController_BSPIM_sR8_Dp_u0__D0_D1_REG EQU CYREG_B1_UDB08_D0_D1
RadioController_BSPIM_sR8_Dp_u0__D0_REG EQU CYREG_B1_UDB08_D0
RadioController_BSPIM_sR8_Dp_u0__D1_REG EQU CYREG_B1_UDB08_D1
RadioController_BSPIM_sR8_Dp_u0__DP_AUX_CTL_REG EQU CYREG_B1_UDB08_ACTL
RadioController_BSPIM_sR8_Dp_u0__F0_F1_REG EQU CYREG_B1_UDB08_F0_F1
RadioController_BSPIM_sR8_Dp_u0__F0_REG EQU CYREG_B1_UDB08_F0
RadioController_BSPIM_sR8_Dp_u0__F1_REG EQU CYREG_B1_UDB08_F1

; LED_Control_Reg
LED_Control_Reg_ctrl_reg__0__MASK EQU 0x01
LED_Control_Reg_ctrl_reg__0__POS EQU 0
LED_Control_Reg_ctrl_reg__16BIT_CONTROL_AUX_CTL_REG EQU CYREG_B0_UDB12_13_ACTL
LED_Control_Reg_ctrl_reg__16BIT_CONTROL_CONTROL_REG EQU CYREG_B0_UDB12_13_CTL
LED_Control_Reg_ctrl_reg__16BIT_CONTROL_COUNT_REG EQU CYREG_B0_UDB12_13_CTL
LED_Control_Reg_ctrl_reg__16BIT_COUNT_CONTROL_REG EQU CYREG_B0_UDB12_13_CTL
LED_Control_Reg_ctrl_reg__16BIT_COUNT_COUNT_REG EQU CYREG_B0_UDB12_13_CTL
LED_Control_Reg_ctrl_reg__16BIT_MASK_MASK_REG EQU CYREG_B0_UDB12_13_MSK
LED_Control_Reg_ctrl_reg__16BIT_MASK_PERIOD_REG EQU CYREG_B0_UDB12_13_MSK
LED_Control_Reg_ctrl_reg__16BIT_PERIOD_MASK_REG EQU CYREG_B0_UDB12_13_MSK
LED_Control_Reg_ctrl_reg__16BIT_PERIOD_PERIOD_REG EQU CYREG_B0_UDB12_13_MSK
LED_Control_Reg_ctrl_reg__1__MASK EQU 0x02
LED_Control_Reg_ctrl_reg__1__POS EQU 1
LED_Control_Reg_ctrl_reg__2__MASK EQU 0x04
LED_Control_Reg_ctrl_reg__2__POS EQU 2
LED_Control_Reg_ctrl_reg__3__MASK EQU 0x08
LED_Control_Reg_ctrl_reg__3__POS EQU 3
LED_Control_Reg_ctrl_reg__4__MASK EQU 0x10
LED_Control_Reg_ctrl_reg__4__POS EQU 4
LED_Control_Reg_ctrl_reg__5__MASK EQU 0x20
LED_Control_Reg_ctrl_reg__5__POS EQU 5
LED_Control_Reg_ctrl_reg__6__MASK EQU 0x40
LED_Control_Reg_ctrl_reg__6__POS EQU 6
LED_Control_Reg_ctrl_reg__7__MASK EQU 0x80
LED_Control_Reg_ctrl_reg__7__POS EQU 7
LED_Control_Reg_ctrl_reg__CONTROL_AUX_CTL_REG EQU CYREG_B0_UDB12_ACTL
LED_Control_Reg_ctrl_reg__CONTROL_REG EQU CYREG_B0_UDB12_CTL
LED_Control_Reg_ctrl_reg__CONTROL_ST_REG EQU CYREG_B0_UDB12_ST_CTL
LED_Control_Reg_ctrl_reg__COUNT_REG EQU CYREG_B0_UDB12_CTL
LED_Control_Reg_ctrl_reg__COUNT_ST_REG EQU CYREG_B0_UDB12_ST_CTL
LED_Control_Reg_ctrl_reg__MASK EQU 0xFF
LED_Control_Reg_ctrl_reg__MASK_CTL_AUX_CTL_REG EQU CYREG_B0_UDB12_MSK_ACTL
LED_Control_Reg_ctrl_reg__PERIOD_REG EQU CYREG_B0_UDB12_MSK
LED_Control_Reg_ctrl_reg__PER_CTL_AUX_CTL_REG EQU CYREG_B0_UDB12_MSK_ACTL

; LCD_LCDPort
LCD_LCDPort__0__MASK EQU 0x01
LCD_LCDPort__0__PC EQU CYREG_PRT0_PC0
LCD_LCDPort__0__PORT EQU 0
LCD_LCDPort__0__SHIFT EQU 0
LCD_LCDPort__1__MASK EQU 0x02
LCD_LCDPort__1__PC EQU CYREG_PRT0_PC1
LCD_LCDPort__1__PORT EQU 0
LCD_LCDPort__1__SHIFT EQU 1
LCD_LCDPort__2__MASK EQU 0x04
LCD_LCDPort__2__PC EQU CYREG_PRT0_PC2
LCD_LCDPort__2__PORT EQU 0
LCD_LCDPort__2__SHIFT EQU 2
LCD_LCDPort__3__MASK EQU 0x08
LCD_LCDPort__3__PC EQU CYREG_PRT0_PC3
LCD_LCDPort__3__PORT EQU 0
LCD_LCDPort__3__SHIFT EQU 3
LCD_LCDPort__4__MASK EQU 0x10
LCD_LCDPort__4__PC EQU CYREG_PRT0_PC4
LCD_LCDPort__4__PORT EQU 0
LCD_LCDPort__4__SHIFT EQU 4
LCD_LCDPort__5__MASK EQU 0x20
LCD_LCDPort__5__PC EQU CYREG_PRT0_PC5
LCD_LCDPort__5__PORT EQU 0
LCD_LCDPort__5__SHIFT EQU 5
LCD_LCDPort__6__MASK EQU 0x40
LCD_LCDPort__6__PC EQU CYREG_PRT0_PC6
LCD_LCDPort__6__PORT EQU 0
LCD_LCDPort__6__SHIFT EQU 6
LCD_LCDPort__AG EQU CYREG_PRT0_AG
LCD_LCDPort__AMUX EQU CYREG_PRT0_AMUX
LCD_LCDPort__BIE EQU CYREG_PRT0_BIE
LCD_LCDPort__BIT_MASK EQU CYREG_PRT0_BIT_MASK
LCD_LCDPort__BYP EQU CYREG_PRT0_BYP
LCD_LCDPort__CTL EQU CYREG_PRT0_CTL
LCD_LCDPort__DM0 EQU CYREG_PRT0_DM0
LCD_LCDPort__DM1 EQU CYREG_PRT0_DM1
LCD_LCDPort__DM2 EQU CYREG_PRT0_DM2
LCD_LCDPort__DR EQU CYREG_PRT0_DR
LCD_LCDPort__INP_DIS EQU CYREG_PRT0_INP_DIS
LCD_LCDPort__LCD_COM_SEG EQU CYREG_PRT0_LCD_COM_SEG
LCD_LCDPort__LCD_EN EQU CYREG_PRT0_LCD_EN
LCD_LCDPort__MASK EQU 0x7F
LCD_LCDPort__PORT EQU 0
LCD_LCDPort__PRT EQU CYREG_PRT0_PRT
LCD_LCDPort__PRTDSI__CAPS_SEL EQU CYREG_PRT0_CAPS_SEL
LCD_LCDPort__PRTDSI__DBL_SYNC_IN EQU CYREG_PRT0_DBL_SYNC_IN
LCD_LCDPort__PRTDSI__OE_SEL0 EQU CYREG_PRT0_OE_SEL0
LCD_LCDPort__PRTDSI__OE_SEL1 EQU CYREG_PRT0_OE_SEL1
LCD_LCDPort__PRTDSI__OUT_SEL0 EQU CYREG_PRT0_OUT_SEL0
LCD_LCDPort__PRTDSI__OUT_SEL1 EQU CYREG_PRT0_OUT_SEL1
LCD_LCDPort__PRTDSI__SYNC_OUT EQU CYREG_PRT0_SYNC_OUT
LCD_LCDPort__PS EQU CYREG_PRT0_PS
LCD_LCDPort__SHIFT EQU 0
LCD_LCDPort__SLW EQU CYREG_PRT0_SLW

; Button
Button__0__MASK EQU 0x08
Button__0__PC EQU CYREG_IO_PC_PRT15_PC3
Button__0__PORT EQU 15
Button__0__SHIFT EQU 3
Button__AG EQU CYREG_PRT15_AG
Button__AMUX EQU CYREG_PRT15_AMUX
Button__BIE EQU CYREG_PRT15_BIE
Button__BIT_MASK EQU CYREG_PRT15_BIT_MASK
Button__BYP EQU CYREG_PRT15_BYP
Button__CTL EQU CYREG_PRT15_CTL
Button__DM0 EQU CYREG_PRT15_DM0
Button__DM1 EQU CYREG_PRT15_DM1
Button__DM2 EQU CYREG_PRT15_DM2
Button__DR EQU CYREG_PRT15_DR
Button__INP_DIS EQU CYREG_PRT15_INP_DIS
Button__LCD_COM_SEG EQU CYREG_PRT15_LCD_COM_SEG
Button__LCD_EN EQU CYREG_PRT15_LCD_EN
Button__MASK EQU 0x08
Button__PORT EQU 15
Button__PRT EQU CYREG_PRT15_PRT
Button__PRTDSI__CAPS_SEL EQU CYREG_PRT15_CAPS_SEL
Button__PRTDSI__DBL_SYNC_IN EQU CYREG_PRT15_DBL_SYNC_IN
Button__PRTDSI__OE_SEL0 EQU CYREG_PRT15_OE_SEL0
Button__PRTDSI__OE_SEL1 EQU CYREG_PRT15_OE_SEL1
Button__PRTDSI__OUT_SEL0 EQU CYREG_PRT15_OUT_SEL0
Button__PRTDSI__OUT_SEL1 EQU CYREG_PRT15_OUT_SEL1
Button__PRTDSI__SYNC_OUT EQU CYREG_PRT15_SYNC_OUT
Button__PS EQU CYREG_PRT15_PS
Button__SHIFT EQU 3
Button__SLW EQU CYREG_PRT15_SLW

; LED_0
LED_0__0__MASK EQU 0x08
LED_0__0__PC EQU CYREG_PRT4_PC3
LED_0__0__PORT EQU 4
LED_0__0__SHIFT EQU 3
LED_0__AG EQU CYREG_PRT4_AG
LED_0__AMUX EQU CYREG_PRT4_AMUX
LED_0__BIE EQU CYREG_PRT4_BIE
LED_0__BIT_MASK EQU CYREG_PRT4_BIT_MASK
LED_0__BYP EQU CYREG_PRT4_BYP
LED_0__CTL EQU CYREG_PRT4_CTL
LED_0__DM0 EQU CYREG_PRT4_DM0
LED_0__DM1 EQU CYREG_PRT4_DM1
LED_0__DM2 EQU CYREG_PRT4_DM2
LED_0__DR EQU CYREG_PRT4_DR
LED_0__INP_DIS EQU CYREG_PRT4_INP_DIS
LED_0__LCD_COM_SEG EQU CYREG_PRT4_LCD_COM_SEG
LED_0__LCD_EN EQU CYREG_PRT4_LCD_EN
LED_0__MASK EQU 0x08
LED_0__PORT EQU 4
LED_0__PRT EQU CYREG_PRT4_PRT
LED_0__PRTDSI__CAPS_SEL EQU CYREG_PRT4_CAPS_SEL
LED_0__PRTDSI__DBL_SYNC_IN EQU CYREG_PRT4_DBL_SYNC_IN
LED_0__PRTDSI__OE_SEL0 EQU CYREG_PRT4_OE_SEL0
LED_0__PRTDSI__OE_SEL1 EQU CYREG_PRT4_OE_SEL1
LED_0__PRTDSI__OUT_SEL0 EQU CYREG_PRT4_OUT_SEL0
LED_0__PRTDSI__OUT_SEL1 EQU CYREG_PRT4_OUT_SEL1
LED_0__PRTDSI__SYNC_OUT EQU CYREG_PRT4_SYNC_OUT
LED_0__PS EQU CYREG_PRT4_PS
LED_0__SHIFT EQU 3
LED_0__SLW EQU CYREG_PRT4_SLW

; LED_1
LED_1__0__MASK EQU 0x04
LED_1__0__PC EQU CYREG_PRT4_PC2
LED_1__0__PORT EQU 4
LED_1__0__SHIFT EQU 2
LED_1__AG EQU CYREG_PRT4_AG
LED_1__AMUX EQU CYREG_PRT4_AMUX
LED_1__BIE EQU CYREG_PRT4_BIE
LED_1__BIT_MASK EQU CYREG_PRT4_BIT_MASK
LED_1__BYP EQU CYREG_PRT4_BYP
LED_1__CTL EQU CYREG_PRT4_CTL
LED_1__DM0 EQU CYREG_PRT4_DM0
LED_1__DM1 EQU CYREG_PRT4_DM1
LED_1__DM2 EQU CYREG_PRT4_DM2
LED_1__DR EQU CYREG_PRT4_DR
LED_1__INP_DIS EQU CYREG_PRT4_INP_DIS
LED_1__LCD_COM_SEG EQU CYREG_PRT4_LCD_COM_SEG
LED_1__LCD_EN EQU CYREG_PRT4_LCD_EN
LED_1__MASK EQU 0x04
LED_1__PORT EQU 4
LED_1__PRT EQU CYREG_PRT4_PRT
LED_1__PRTDSI__CAPS_SEL EQU CYREG_PRT4_CAPS_SEL
LED_1__PRTDSI__DBL_SYNC_IN EQU CYREG_PRT4_DBL_SYNC_IN
LED_1__PRTDSI__OE_SEL0 EQU CYREG_PRT4_OE_SEL0
LED_1__PRTDSI__OE_SEL1 EQU CYREG_PRT4_OE_SEL1
LED_1__PRTDSI__OUT_SEL0 EQU CYREG_PRT4_OUT_SEL0
LED_1__PRTDSI__OUT_SEL1 EQU CYREG_PRT4_OUT_SEL1
LED_1__PRTDSI__SYNC_OUT EQU CYREG_PRT4_SYNC_OUT
LED_1__PS EQU CYREG_PRT4_PS
LED_1__SHIFT EQU 2
LED_1__SLW EQU CYREG_PRT4_SLW

; LED_2
LED_2__0__MASK EQU 0x02
LED_2__0__PC EQU CYREG_PRT4_PC1
LED_2__0__PORT EQU 4
LED_2__0__SHIFT EQU 1
LED_2__AG EQU CYREG_PRT4_AG
LED_2__AMUX EQU CYREG_PRT4_AMUX
LED_2__BIE EQU CYREG_PRT4_BIE
LED_2__BIT_MASK EQU CYREG_PRT4_BIT_MASK
LED_2__BYP EQU CYREG_PRT4_BYP
LED_2__CTL EQU CYREG_PRT4_CTL
LED_2__DM0 EQU CYREG_PRT4_DM0
LED_2__DM1 EQU CYREG_PRT4_DM1
LED_2__DM2 EQU CYREG_PRT4_DM2
LED_2__DR EQU CYREG_PRT4_DR
LED_2__INP_DIS EQU CYREG_PRT4_INP_DIS
LED_2__LCD_COM_SEG EQU CYREG_PRT4_LCD_COM_SEG
LED_2__LCD_EN EQU CYREG_PRT4_LCD_EN
LED_2__MASK EQU 0x02
LED_2__PORT EQU 4
LED_2__PRT EQU CYREG_PRT4_PRT
LED_2__PRTDSI__CAPS_SEL EQU CYREG_PRT4_CAPS_SEL
LED_2__PRTDSI__DBL_SYNC_IN EQU CYREG_PRT4_DBL_SYNC_IN
LED_2__PRTDSI__OE_SEL0 EQU CYREG_PRT4_OE_SEL0
LED_2__PRTDSI__OE_SEL1 EQU CYREG_PRT4_OE_SEL1
LED_2__PRTDSI__OUT_SEL0 EQU CYREG_PRT4_OUT_SEL0
LED_2__PRTDSI__OUT_SEL1 EQU CYREG_PRT4_OUT_SEL1
LED_2__PRTDSI__SYNC_OUT EQU CYREG_PRT4_SYNC_OUT
LED_2__PS EQU CYREG_PRT4_PS
LED_2__SHIFT EQU 1
LED_2__SLW EQU CYREG_PRT4_SLW

; LED_3
LED_3__0__MASK EQU 0x01
LED_3__0__PC EQU CYREG_PRT4_PC0
LED_3__0__PORT EQU 4
LED_3__0__SHIFT EQU 0
LED_3__AG EQU CYREG_PRT4_AG
LED_3__AMUX EQU CYREG_PRT4_AMUX
LED_3__BIE EQU CYREG_PRT4_BIE
LED_3__BIT_MASK EQU CYREG_PRT4_BIT_MASK
LED_3__BYP EQU CYREG_PRT4_BYP
LED_3__CTL EQU CYREG_PRT4_CTL
LED_3__DM0 EQU CYREG_PRT4_DM0
LED_3__DM1 EQU CYREG_PRT4_DM1
LED_3__DM2 EQU CYREG_PRT4_DM2
LED_3__DR EQU CYREG_PRT4_DR
LED_3__INP_DIS EQU CYREG_PRT4_INP_DIS
LED_3__LCD_COM_SEG EQU CYREG_PRT4_LCD_COM_SEG
LED_3__LCD_EN EQU CYREG_PRT4_LCD_EN
LED_3__MASK EQU 0x01
LED_3__PORT EQU 4
LED_3__PRT EQU CYREG_PRT4_PRT
LED_3__PRTDSI__CAPS_SEL EQU CYREG_PRT4_CAPS_SEL
LED_3__PRTDSI__DBL_SYNC_IN EQU CYREG_PRT4_DBL_SYNC_IN
LED_3__PRTDSI__OE_SEL0 EQU CYREG_PRT4_OE_SEL0
LED_3__PRTDSI__OE_SEL1 EQU CYREG_PRT4_OE_SEL1
LED_3__PRTDSI__OUT_SEL0 EQU CYREG_PRT4_OUT_SEL0
LED_3__PRTDSI__OUT_SEL1 EQU CYREG_PRT4_OUT_SEL1
LED_3__PRTDSI__SYNC_OUT EQU CYREG_PRT4_SYNC_OUT
LED_3__PS EQU CYREG_PRT4_PS
LED_3__SHIFT EQU 0
LED_3__SLW EQU CYREG_PRT4_SLW

; LED_4
LED_4__0__MASK EQU 0x08
LED_4__0__PC EQU CYREG_PRT2_PC3
LED_4__0__PORT EQU 2
LED_4__0__SHIFT EQU 3
LED_4__AG EQU CYREG_PRT2_AG
LED_4__AMUX EQU CYREG_PRT2_AMUX
LED_4__BIE EQU CYREG_PRT2_BIE
LED_4__BIT_MASK EQU CYREG_PRT2_BIT_MASK
LED_4__BYP EQU CYREG_PRT2_BYP
LED_4__CTL EQU CYREG_PRT2_CTL
LED_4__DM0 EQU CYREG_PRT2_DM0
LED_4__DM1 EQU CYREG_PRT2_DM1
LED_4__DM2 EQU CYREG_PRT2_DM2
LED_4__DR EQU CYREG_PRT2_DR
LED_4__INP_DIS EQU CYREG_PRT2_INP_DIS
LED_4__LCD_COM_SEG EQU CYREG_PRT2_LCD_COM_SEG
LED_4__LCD_EN EQU CYREG_PRT2_LCD_EN
LED_4__MASK EQU 0x08
LED_4__PORT EQU 2
LED_4__PRT EQU CYREG_PRT2_PRT
LED_4__PRTDSI__CAPS_SEL EQU CYREG_PRT2_CAPS_SEL
LED_4__PRTDSI__DBL_SYNC_IN EQU CYREG_PRT2_DBL_SYNC_IN
LED_4__PRTDSI__OE_SEL0 EQU CYREG_PRT2_OE_SEL0
LED_4__PRTDSI__OE_SEL1 EQU CYREG_PRT2_OE_SEL1
LED_4__PRTDSI__OUT_SEL0 EQU CYREG_PRT2_OUT_SEL0
LED_4__PRTDSI__OUT_SEL1 EQU CYREG_PRT2_OUT_SEL1
LED_4__PRTDSI__SYNC_OUT EQU CYREG_PRT2_SYNC_OUT
LED_4__PS EQU CYREG_PRT2_PS
LED_4__SHIFT EQU 3
LED_4__SLW EQU CYREG_PRT2_SLW

; LED_5
LED_5__0__MASK EQU 0x04
LED_5__0__PC EQU CYREG_PRT2_PC2
LED_5__0__PORT EQU 2
LED_5__0__SHIFT EQU 2
LED_5__AG EQU CYREG_PRT2_AG
LED_5__AMUX EQU CYREG_PRT2_AMUX
LED_5__BIE EQU CYREG_PRT2_BIE
LED_5__BIT_MASK EQU CYREG_PRT2_BIT_MASK
LED_5__BYP EQU CYREG_PRT2_BYP
LED_5__CTL EQU CYREG_PRT2_CTL
LED_5__DM0 EQU CYREG_PRT2_DM0
LED_5__DM1 EQU CYREG_PRT2_DM1
LED_5__DM2 EQU CYREG_PRT2_DM2
LED_5__DR EQU CYREG_PRT2_DR
LED_5__INP_DIS EQU CYREG_PRT2_INP_DIS
LED_5__LCD_COM_SEG EQU CYREG_PRT2_LCD_COM_SEG
LED_5__LCD_EN EQU CYREG_PRT2_LCD_EN
LED_5__MASK EQU 0x04
LED_5__PORT EQU 2
LED_5__PRT EQU CYREG_PRT2_PRT
LED_5__PRTDSI__CAPS_SEL EQU CYREG_PRT2_CAPS_SEL
LED_5__PRTDSI__DBL_SYNC_IN EQU CYREG_PRT2_DBL_SYNC_IN
LED_5__PRTDSI__OE_SEL0 EQU CYREG_PRT2_OE_SEL0
LED_5__PRTDSI__OE_SEL1 EQU CYREG_PRT2_OE_SEL1
LED_5__PRTDSI__OUT_SEL0 EQU CYREG_PRT2_OUT_SEL0
LED_5__PRTDSI__OUT_SEL1 EQU CYREG_PRT2_OUT_SEL1
LED_5__PRTDSI__SYNC_OUT EQU CYREG_PRT2_SYNC_OUT
LED_5__PS EQU CYREG_PRT2_PS
LED_5__SHIFT EQU 2
LED_5__SLW EQU CYREG_PRT2_SLW

; LED_6
LED_6__0__MASK EQU 0x02
LED_6__0__PC EQU CYREG_PRT2_PC1
LED_6__0__PORT EQU 2
LED_6__0__SHIFT EQU 1
LED_6__AG EQU CYREG_PRT2_AG
LED_6__AMUX EQU CYREG_PRT2_AMUX
LED_6__BIE EQU CYREG_PRT2_BIE
LED_6__BIT_MASK EQU CYREG_PRT2_BIT_MASK
LED_6__BYP EQU CYREG_PRT2_BYP
LED_6__CTL EQU CYREG_PRT2_CTL
LED_6__DM0 EQU CYREG_PRT2_DM0
LED_6__DM1 EQU CYREG_PRT2_DM1
LED_6__DM2 EQU CYREG_PRT2_DM2
LED_6__DR EQU CYREG_PRT2_DR
LED_6__INP_DIS EQU CYREG_PRT2_INP_DIS
LED_6__LCD_COM_SEG EQU CYREG_PRT2_LCD_COM_SEG
LED_6__LCD_EN EQU CYREG_PRT2_LCD_EN
LED_6__MASK EQU 0x02
LED_6__PORT EQU 2
LED_6__PRT EQU CYREG_PRT2_PRT
LED_6__PRTDSI__CAPS_SEL EQU CYREG_PRT2_CAPS_SEL
LED_6__PRTDSI__DBL_SYNC_IN EQU CYREG_PRT2_DBL_SYNC_IN
LED_6__PRTDSI__OE_SEL0 EQU CYREG_PRT2_OE_SEL0
LED_6__PRTDSI__OE_SEL1 EQU CYREG_PRT2_OE_SEL1
LED_6__PRTDSI__OUT_SEL0 EQU CYREG_PRT2_OUT_SEL0
LED_6__PRTDSI__OUT_SEL1 EQU CYREG_PRT2_OUT_SEL1
LED_6__PRTDSI__SYNC_OUT EQU CYREG_PRT2_SYNC_OUT
LED_6__PS EQU CYREG_PRT2_PS
LED_6__SHIFT EQU 1
LED_6__SLW EQU CYREG_PRT2_SLW

; LED_7
LED_7__0__MASK EQU 0x01
LED_7__0__PC EQU CYREG_PRT2_PC0
LED_7__0__PORT EQU 2
LED_7__0__SHIFT EQU 0
LED_7__AG EQU CYREG_PRT2_AG
LED_7__AMUX EQU CYREG_PRT2_AMUX
LED_7__BIE EQU CYREG_PRT2_BIE
LED_7__BIT_MASK EQU CYREG_PRT2_BIT_MASK
LED_7__BYP EQU CYREG_PRT2_BYP
LED_7__CTL EQU CYREG_PRT2_CTL
LED_7__DM0 EQU CYREG_PRT2_DM0
LED_7__DM1 EQU CYREG_PRT2_DM1
LED_7__DM2 EQU CYREG_PRT2_DM2
LED_7__DR EQU CYREG_PRT2_DR
LED_7__INP_DIS EQU CYREG_PRT2_INP_DIS
LED_7__LCD_COM_SEG EQU CYREG_PRT2_LCD_COM_SEG
LED_7__LCD_EN EQU CYREG_PRT2_LCD_EN
LED_7__MASK EQU 0x01
LED_7__PORT EQU 2
LED_7__PRT EQU CYREG_PRT2_PRT
LED_7__PRTDSI__CAPS_SEL EQU CYREG_PRT2_CAPS_SEL
LED_7__PRTDSI__DBL_SYNC_IN EQU CYREG_PRT2_DBL_SYNC_IN
LED_7__PRTDSI__OE_SEL0 EQU CYREG_PRT2_OE_SEL0
LED_7__PRTDSI__OE_SEL1 EQU CYREG_PRT2_OE_SEL1
LED_7__PRTDSI__OUT_SEL0 EQU CYREG_PRT2_OUT_SEL0
LED_7__PRTDSI__OUT_SEL1 EQU CYREG_PRT2_OUT_SEL1
LED_7__PRTDSI__SYNC_OUT EQU CYREG_PRT2_SYNC_OUT
LED_7__PS EQU CYREG_PRT2_PS
LED_7__SHIFT EQU 0
LED_7__SLW EQU CYREG_PRT2_SLW

; MISO
MISO__0__MASK EQU 0x10
MISO__0__PC EQU CYREG_PRT1_PC4
MISO__0__PORT EQU 1
MISO__0__SHIFT EQU 4
MISO__AG EQU CYREG_PRT1_AG
MISO__AMUX EQU CYREG_PRT1_AMUX
MISO__BIE EQU CYREG_PRT1_BIE
MISO__BIT_MASK EQU CYREG_PRT1_BIT_MASK
MISO__BYP EQU CYREG_PRT1_BYP
MISO__CTL EQU CYREG_PRT1_CTL
MISO__DM0 EQU CYREG_PRT1_DM0
MISO__DM1 EQU CYREG_PRT1_DM1
MISO__DM2 EQU CYREG_PRT1_DM2
MISO__DR EQU CYREG_PRT1_DR
MISO__INP_DIS EQU CYREG_PRT1_INP_DIS
MISO__LCD_COM_SEG EQU CYREG_PRT1_LCD_COM_SEG
MISO__LCD_EN EQU CYREG_PRT1_LCD_EN
MISO__MASK EQU 0x10
MISO__PORT EQU 1
MISO__PRT EQU CYREG_PRT1_PRT
MISO__PRTDSI__CAPS_SEL EQU CYREG_PRT1_CAPS_SEL
MISO__PRTDSI__DBL_SYNC_IN EQU CYREG_PRT1_DBL_SYNC_IN
MISO__PRTDSI__OE_SEL0 EQU CYREG_PRT1_OE_SEL0
MISO__PRTDSI__OE_SEL1 EQU CYREG_PRT1_OE_SEL1
MISO__PRTDSI__OUT_SEL0 EQU CYREG_PRT1_OUT_SEL0
MISO__PRTDSI__OUT_SEL1 EQU CYREG_PRT1_OUT_SEL1
MISO__PRTDSI__SYNC_OUT EQU CYREG_PRT1_SYNC_OUT
MISO__PS EQU CYREG_PRT1_PS
MISO__SHIFT EQU 4
MISO__SLW EQU CYREG_PRT1_SLW

; MOSI
MOSI__0__MASK EQU 0x01
MOSI__0__PC EQU CYREG_PRT12_PC0
MOSI__0__PORT EQU 12
MOSI__0__SHIFT EQU 0
MOSI__AG EQU CYREG_PRT12_AG
MOSI__BIE EQU CYREG_PRT12_BIE
MOSI__BIT_MASK EQU CYREG_PRT12_BIT_MASK
MOSI__BYP EQU CYREG_PRT12_BYP
MOSI__DM0 EQU CYREG_PRT12_DM0
MOSI__DM1 EQU CYREG_PRT12_DM1
MOSI__DM2 EQU CYREG_PRT12_DM2
MOSI__DR EQU CYREG_PRT12_DR
MOSI__INP_DIS EQU CYREG_PRT12_INP_DIS
MOSI__MASK EQU 0x01
MOSI__PORT EQU 12
MOSI__PRT EQU CYREG_PRT12_PRT
MOSI__PRTDSI__DBL_SYNC_IN EQU CYREG_PRT12_DBL_SYNC_IN
MOSI__PRTDSI__OE_SEL0 EQU CYREG_PRT12_OE_SEL0
MOSI__PRTDSI__OE_SEL1 EQU CYREG_PRT12_OE_SEL1
MOSI__PRTDSI__OUT_SEL0 EQU CYREG_PRT12_OUT_SEL0
MOSI__PRTDSI__OUT_SEL1 EQU CYREG_PRT12_OUT_SEL1
MOSI__PRTDSI__SYNC_OUT EQU CYREG_PRT12_SYNC_OUT
MOSI__PS EQU CYREG_PRT12_PS
MOSI__SHIFT EQU 0
MOSI__SIO_CFG EQU CYREG_PRT12_SIO_CFG
MOSI__SIO_DIFF EQU CYREG_PRT12_SIO_DIFF
MOSI__SIO_HYST_EN EQU CYREG_PRT12_SIO_HYST_EN
MOSI__SIO_REG_HIFREQ EQU CYREG_PRT12_SIO_REG_HIFREQ
MOSI__SLW EQU CYREG_PRT12_SLW

; SCLK
SCLK__0__MASK EQU 0x01
SCLK__0__PC EQU CYREG_PRT5_PC0
SCLK__0__PORT EQU 5
SCLK__0__SHIFT EQU 0
SCLK__AG EQU CYREG_PRT5_AG
SCLK__AMUX EQU CYREG_PRT5_AMUX
SCLK__BIE EQU CYREG_PRT5_BIE
SCLK__BIT_MASK EQU CYREG_PRT5_BIT_MASK
SCLK__BYP EQU CYREG_PRT5_BYP
SCLK__CTL EQU CYREG_PRT5_CTL
SCLK__DM0 EQU CYREG_PRT5_DM0
SCLK__DM1 EQU CYREG_PRT5_DM1
SCLK__DM2 EQU CYREG_PRT5_DM2
SCLK__DR EQU CYREG_PRT5_DR
SCLK__INP_DIS EQU CYREG_PRT5_INP_DIS
SCLK__LCD_COM_SEG EQU CYREG_PRT5_LCD_COM_SEG
SCLK__LCD_EN EQU CYREG_PRT5_LCD_EN
SCLK__MASK EQU 0x01
SCLK__PORT EQU 5
SCLK__PRT EQU CYREG_PRT5_PRT
SCLK__PRTDSI__CAPS_SEL EQU CYREG_PRT5_CAPS_SEL
SCLK__PRTDSI__DBL_SYNC_IN EQU CYREG_PRT5_DBL_SYNC_IN
SCLK__PRTDSI__OE_SEL0 EQU CYREG_PRT5_OE_SEL0
SCLK__PRTDSI__OE_SEL1 EQU CYREG_PRT5_OE_SEL1
SCLK__PRTDSI__OUT_SEL0 EQU CYREG_PRT5_OUT_SEL0
SCLK__PRTDSI__OUT_SEL1 EQU CYREG_PRT5_OUT_SEL1
SCLK__PRTDSI__SYNC_OUT EQU CYREG_PRT5_SYNC_OUT
SCLK__PS EQU CYREG_PRT5_PS
SCLK__SHIFT EQU 0
SCLK__SLW EQU CYREG_PRT5_SLW

; SS
SS__0__MASK EQU 0x08
SS__0__PC EQU CYREG_PRT5_PC3
SS__0__PORT EQU 5
SS__0__SHIFT EQU 3
SS__AG EQU CYREG_PRT5_AG
SS__AMUX EQU CYREG_PRT5_AMUX
SS__BIE EQU CYREG_PRT5_BIE
SS__BIT_MASK EQU CYREG_PRT5_BIT_MASK
SS__BYP EQU CYREG_PRT5_BYP
SS__CTL EQU CYREG_PRT5_CTL
SS__DM0 EQU CYREG_PRT5_DM0
SS__DM1 EQU CYREG_PRT5_DM1
SS__DM2 EQU CYREG_PRT5_DM2
SS__DR EQU CYREG_PRT5_DR
SS__INP_DIS EQU CYREG_PRT5_INP_DIS
SS__LCD_COM_SEG EQU CYREG_PRT5_LCD_COM_SEG
SS__LCD_EN EQU CYREG_PRT5_LCD_EN
SS__MASK EQU 0x08
SS__PORT EQU 5
SS__PRT EQU CYREG_PRT5_PRT
SS__PRTDSI__CAPS_SEL EQU CYREG_PRT5_CAPS_SEL
SS__PRTDSI__DBL_SYNC_IN EQU CYREG_PRT5_DBL_SYNC_IN
SS__PRTDSI__OE_SEL0 EQU CYREG_PRT5_OE_SEL0
SS__PRTDSI__OE_SEL1 EQU CYREG_PRT5_OE_SEL1
SS__PRTDSI__OUT_SEL0 EQU CYREG_PRT5_OUT_SEL0
SS__PRTDSI__OUT_SEL1 EQU CYREG_PRT5_OUT_SEL1
SS__PRTDSI__SYNC_OUT EQU CYREG_PRT5_SYNC_OUT
SS__PS EQU CYREG_PRT5_PS
SS__SHIFT EQU 3
SS__SLW EQU CYREG_PRT5_SLW

; Miscellaneous
; -- WARNING: define names containting LEOPARD or PANTHER are deprecated and will be removed in a future release
CYDEV_BOOTLOADER_IO_COMP_CUSTOM_IO EQU 0
CYDEV_DEBUGGING_DPS_SWD EQU 2
CYDEV_CONFIG_UNUSED_IO_AllowButWarn EQU 0
CYDEV_CONFIGURATION_MODE_DMA EQU 2
CYDEV_CONFIG_FASTBOOT_ENABLED EQU 1
CYDEV_CHIP_REV_LEOPARD_PRODUCTION EQU 3
CYDEV_CHIP_REVISION_3A_PRODUCTION EQU 3
CYDEV_CHIP_MEMBER_3A EQU 1
CYDEV_CHIP_FAMILY_PSOC3 EQU 1
CYDEV_CHIP_DIE_LEOPARD EQU 1
CYDEV_CHIP_DIE_EXPECT EQU CYDEV_CHIP_DIE_LEOPARD
CYDEV_BOOTLOADER_CHECKSUM_BASIC EQU 0
BCLK__BUS_CLK__HZ EQU 24000000
BCLK__BUS_CLK__KHZ EQU 24000
BCLK__BUS_CLK__MHZ EQU 24
CYDEV_APPLICATION_ID EQU 0x0000
CYDEV_APPLICATION_VERSION EQU 0x0000
CYDEV_BOOTLOADER_CHECKSUM EQU CYDEV_BOOTLOADER_CHECKSUM_BASIC
CYDEV_BOOTLOADER_CHECKSUM_CRC EQU 1
CYDEV_BOOTLOADER_FAST_VERIFY EQU 0
CYDEV_BOOTLOADER_VERSION EQU 0x0000
CYDEV_BOOTLOADER_WAIT_COMMAND EQU 1
CYDEV_BOOTLOADER_WAIT_TIME EQU 200
CYDEV_CHIP_DIE_ACTUAL EQU CYDEV_CHIP_DIE_EXPECT
CYDEV_CHIP_DIE_PANTHER EQU 2
CYDEV_CHIP_DIE_UNKNOWN EQU 0
CYDEV_CHIP_FAMILY_PSOC4 EQU 2
CYDEV_CHIP_FAMILY_PSOC5 EQU 3
CYDEV_CHIP_FAMILY_UNKNOWN EQU 0
CYDEV_CHIP_FAMILY_USED EQU CYDEV_CHIP_FAMILY_PSOC3
CYDEV_CHIP_JTAG_ID EQU 0x1E028069
CYDEV_CHIP_MEMBER_5A EQU 2
CYDEV_CHIP_MEMBER_UNKNOWN EQU 0
CYDEV_CHIP_MEMBER_USED EQU CYDEV_CHIP_MEMBER_3A
CYDEV_CHIP_REVISION_3A_ES1 EQU 0
CYDEV_CHIP_REVISION_3A_ES2 EQU 1
CYDEV_CHIP_REVISION_3A_ES3 EQU 3
CYDEV_CHIP_REVISION_5A_ES0 EQU 0
CYDEV_CHIP_REVISION_5A_ES1 EQU 1
CYDEV_CHIP_REVISION_5A_PRODUCTION EQU 1
CYDEV_CHIP_REVISION_USED EQU CYDEV_CHIP_REVISION_3A_PRODUCTION
CYDEV_CHIP_REV_EXPECT EQU CYDEV_CHIP_REV_LEOPARD_PRODUCTION
CYDEV_CHIP_REV_LEOPARD_ES1 EQU 0
CYDEV_CHIP_REV_LEOPARD_ES2 EQU 1
CYDEV_CHIP_REV_LEOPARD_ES3 EQU 3
CYDEV_CHIP_REV_PANTHER_ES0 EQU 0
CYDEV_CHIP_REV_PANTHER_ES1 EQU 1
CYDEV_CHIP_REV_PANTHER_PRODUCTION EQU 1
CYDEV_CONFIGURATION_CLEAR_SRAM EQU 1
CYDEV_CONFIGURATION_COMPRESSED EQU 0
CYDEV_CONFIGURATION_DMA EQU 1
CYDEV_CONFIGURATION_ECC EQU 1
CYDEV_CONFIGURATION_IMOENABLED EQU CYDEV_CONFIG_FASTBOOT_ENABLED
CYDEV_CONFIGURATION_MODE EQU CYDEV_CONFIGURATION_MODE_DMA
CYDEV_CONFIGURATION_MODE_COMPRESSED EQU 0
CYDEV_CONFIGURATION_MODE_UNCOMPRESSED EQU 1
CYDEV_CONFIG_FORCE_ROUTE EQU 0
CYDEV_CONFIG_UNUSED_IO EQU CYDEV_CONFIG_UNUSED_IO_AllowButWarn
CYDEV_CONFIG_UNUSED_IO_AllowWithInfo EQU 1
CYDEV_CONFIG_UNUSED_IO_Disallowed EQU 2
CYDEV_CUSTOM_ID EQU 0x00000000
CYDEV_DEBUGGING_DPS EQU CYDEV_DEBUGGING_DPS_SWD
CYDEV_DEBUGGING_DPS_Disable EQU 3
CYDEV_DEBUGGING_DPS_JTAG_4 EQU 1
CYDEV_DEBUGGING_DPS_JTAG_5 EQU 0
CYDEV_DEBUGGING_ENABLE EQU 1
CYDEV_DEBUGGING_REQXRES EQU 1
CYDEV_DEBUGGING_XRES EQU 0
CYDEV_DEBUG_ENABLE_MASK EQU 0x01
CYDEV_DEBUG_ENABLE_REGISTER EQU CYREG_MLOGIC_DEBUG
CYDEV_DMA_CHANNELS_AVAILABLE EQU 24
CYDEV_ECC_ENABLE EQU 0
CYDEV_INSTRUCT_CACHE_ENABLED EQU 1
CYDEV_PROJ_TYPE EQU 0
CYDEV_PROJ_TYPE_BOOTLOADER EQU 1
CYDEV_PROJ_TYPE_LOADABLE EQU 2
CYDEV_PROJ_TYPE_MULTIAPPBOOTLOADER EQU 3
CYDEV_PROJ_TYPE_STANDARD EQU 0
CYDEV_PROTECTION_ENABLE EQU 0
CYDEV_VDDA LIT '5.0'
CYDEV_VDDA_MV EQU 5000
CYDEV_VDDD LIT '5.0'
CYDEV_VDDD_MV EQU 5000
CYDEV_VDDIO0 LIT '5.0'
CYDEV_VDDIO0_MV EQU 5000
CYDEV_VDDIO1 LIT '5.0'
CYDEV_VDDIO1_MV EQU 5000
CYDEV_VDDIO2 LIT '5.0'
CYDEV_VDDIO2_MV EQU 5000
CYDEV_VDDIO3 LIT '5.0'
CYDEV_VDDIO3_MV EQU 5000
CYDEV_VIO0 EQU 5
CYDEV_VIO0_MV EQU 5000
CYDEV_VIO1 EQU 5
CYDEV_VIO1_MV EQU 5000
CYDEV_VIO2 EQU 5
CYDEV_VIO2_MV EQU 5000
CYDEV_VIO3 EQU 5
CYDEV_VIO3_MV EQU 5000
CyBtldr_Custom_Interface EQU CYDEV_BOOTLOADER_IO_COMP_CUSTOM_IO
DMA_CHANNELS_USED__MASK0 EQU 0x00000000
CYDEV_BOOTLOADER_ENABLE EQU 0

#endif /* INCLUDED_CYFITTERKEIL_INC */
